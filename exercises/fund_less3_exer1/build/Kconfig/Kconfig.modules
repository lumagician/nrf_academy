## exercises/fund_less3_exer1/build/Kconfig/Kconfig.modules
```kconfig
menu "nrf (/home/hfl2/nordicsemi/v2.2.0/nrf)"
osource "/home/hfl2/nordicsemi/v2.2.0/nrf/Kconfig.nrf"
config ZEPHYR_NRF_MODULE
	bool
	default y
endmenu
menu "hostap (/home/hfl2/nordicsemi/v2.2.0/modules/lib/hostap)"
osource "/home/hfl2/nordicsemi/v2.2.0/modules/lib/hostap/zephyr/Kconfig"
config ZEPHYR_HOSTAP_MODULE
	bool
	default y
endmenu
menu "mcuboot (/home/hfl2/nordicsemi/v2.2.0/bootloader/mcuboot)"
osource "$(ZEPHYR_MCUBOOT_KCONFIG)"
config ZEPHYR_MCUBOOT_MODULE
	bool
	default y
endmenu
menu "mbedtls (/home/hfl2/nordicsemi/v2.2.0/modules/crypto/mbedtls)"
osource "$(ZEPHYR_MBEDTLS_KCONFIG)"
config ZEPHYR_MBEDTLS_MODULE
	bool
	default y
endmenu
menu "trusted-firmware-m (/home/hfl2/nordicsemi/v2.2.0/modules/tee/tf-m/trusted-firmware-m)"
osource "$(ZEPHYR_TRUSTED_FIRMWARE_M_KCONFIG)"
config ZEPHYR_TRUSTED_FIRMWARE_M_MODULE
	bool
	default y
endmenu
menu "cjson (/home/hfl2/nordicsemi/v2.2.0/modules/lib/cjson)"
osource "$(ZEPHYR_CJSON_KCONFIG)"
config ZEPHYR_CJSON_MODULE
	bool
	default y
endmenu
menu "azure-sdk-for-c (/home/hfl2/nordicsemi/v2.2.0/modules/lib/azure-sdk-for-c)"
osource "$(ZEPHYR_AZURE_SDK_FOR_C_KCONFIG)"
config ZEPHYR_AZURE_SDK_FOR_C_MODULE
	bool
	default y
endmenu
menu "memfault-firmware-sdk (/home/hfl2/nordicsemi/v2.2.0/modules/lib/memfault-firmware-sdk)"
osource "/home/hfl2/nordicsemi/v2.2.0/modules/lib/memfault-firmware-sdk/ports/zephyr/Kconfig"
config ZEPHYR_MEMFAULT_FIRMWARE_SDK_MODULE
	bool
	default y
endmenu
menu "cirrus-logic (/home/hfl2/nordicsemi/v2.2.0/modules/hal/cirrus-logic)"
osource "/home/hfl2/nordicsemi/v2.2.0/modules/hal/cirrus-logic/Kconfig"
config ZEPHYR_CIRRUS_LOGIC_MODULE
	bool
	default y
endmenu
menu "openthread (/home/hfl2/nordicsemi/v2.2.0/modules/lib/openthread)"
osource "$(ZEPHYR_OPENTHREAD_KCONFIG)"
config ZEPHYR_OPENTHREAD_MODULE
	bool
	default y
endmenu
menu "canopennode (/home/hfl2/nordicsemi/v2.2.0/modules/lib/canopennode)"
osource "$(ZEPHYR_CANOPENNODE_KCONFIG)"
config ZEPHYR_CANOPENNODE_MODULE
	bool
	default y
endmenu
menu "chre (/home/hfl2/nordicsemi/v2.2.0/modules/lib/chre)"
osource "/home/hfl2/nordicsemi/v2.2.0/modules/lib/chre/platform/zephyr/Kconfig"
config ZEPHYR_CHRE_MODULE
	bool
	default y
endmenu
menu "hal_nordic (/home/hfl2/nordicsemi/v2.2.0/modules/hal/nordic)"
osource "$(ZEPHYR_HAL_NORDIC_KCONFIG)"
config ZEPHYR_HAL_NORDIC_MODULE
	bool
	default y
endmenu
menu "liblc3 (/home/hfl2/nordicsemi/v2.2.0/modules/lib/liblc3)"
osource "$(ZEPHYR_LIBLC3_KCONFIG)"
config ZEPHYR_LIBLC3_MODULE
	bool
	default y
endmenu
menu "littlefs (/home/hfl2/nordicsemi/v2.2.0/modules/fs/littlefs)"
osource "$(ZEPHYR_LITTLEFS_KCONFIG)"
config ZEPHYR_LITTLEFS_MODULE
	bool
	default y
endmenu
menu "loramac-node (/home/hfl2/nordicsemi/v2.2.0/modules/lib/loramac-node)"
osource "$(ZEPHYR_LORAMAC_NODE_KCONFIG)"
config ZEPHYR_LORAMAC_NODE_MODULE
	bool
	default y
endmenu
menu "lvgl (/home/hfl2/nordicsemi/v2.2.0/modules/lib/gui/lvgl)"
osource "/home/hfl2/nordicsemi/v2.2.0/modules/lib/gui/lvgl/zephyr/Kconfig"
config ZEPHYR_LVGL_MODULE
	bool
	default y
endmenu
menu "lz4 (/home/hfl2/nordicsemi/v2.2.0/modules/lib/lz4)"
osource "$(ZEPHYR_LZ4_KCONFIG)"
config ZEPHYR_LZ4_MODULE
	bool
	default y
endmenu
menu "nanopb (/home/hfl2/nordicsemi/v2.2.0/modules/lib/nanopb)"
osource "$(ZEPHYR_NANOPB_KCONFIG)"
config ZEPHYR_NANOPB_MODULE
	bool
	default y
endmenu
menu "picolibc (/home/hfl2/nordicsemi/v2.2.0/modules/lib/picolibc)"
osource "/home/hfl2/nordicsemi/v2.2.0/modules/lib/picolibc/zephyr/Kconfig"
config ZEPHYR_PICOLIBC_MODULE
	bool
	default y
endmenu
menu "TraceRecorder (/home/hfl2/nordicsemi/v2.2.0/modules/debug/TraceRecorder)"
osource "/home/hfl2/nordicsemi/v2.2.0/modules/debug/TraceRecorder/kernelports/Zephyr/Kconfig"
config ZEPHYR_TRACERECORDER_MODULE
	bool
	default y
endmenu
menu "uoscore-uedhoc (/home/hfl2/nordicsemi/v2.2.0/modules/lib/uoscore-uedhoc)"
osource "$(ZEPHYR_UOSCORE_UEDHOC_KCONFIG)"
config ZEPHYR_UOSCORE_UEDHOC_MODULE
	bool
	default y
endmenu
menu "zcbor (/home/hfl2/nordicsemi/v2.2.0/modules/lib/zcbor)"
osource "$(ZEPHYR_ZCBOR_KCONFIG)"
config ZEPHYR_ZCBOR_MODULE
	bool
	default y
endmenu
menu "zscilib (/home/hfl2/nordicsemi/v2.2.0/modules/lib/zscilib)"
osource "/home/hfl2/nordicsemi/v2.2.0/modules/lib/zscilib/Kconfig.zscilib"
config ZEPHYR_ZSCILIB_MODULE
	bool
	default y
endmenu
menu "nrfxlib (/home/hfl2/nordicsemi/v2.2.0/nrfxlib)"
osource "/home/hfl2/nordicsemi/v2.2.0/nrfxlib/Kconfig.nrfxlib"
config ZEPHYR_NRFXLIB_MODULE
	bool
	default y
endmenu
menu "connectedhomeip (/home/hfl2/nordicsemi/v2.2.0/modules/lib/matter)"
osource "/home/hfl2/nordicsemi/v2.2.0/modules/lib/matter/config/nrfconnect/chip-module/Kconfig"
config ZEPHYR_CONNECTEDHOMEIP_MODULE
	bool
	default y
endmenu
```
